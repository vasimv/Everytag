## boards/arm/hcbb22e/Kconfig.defconfig
```kconfig
# Copyright (c) 2024 Nordic Semiconductor ASA
# SPDX-License-Identifier: Apache-2.0

if BOARD_HCBB22E

config BOARD
  default "hcbb22e"

endif
```

## boards/arm/hcbb22e/Kconfig.hcbb22e
```kconfig
# Copyright (c) 2024 Nordic Semiconductor ASA
# SPDX-License-Identifier: Apache-2.0

config BOARD_HCBB22E
	bool "hcbb22e"
	select SOC_NRF52832_QFAA
```

## boards/arm/kkm_c2_nrf82805/Kconfig
```kconfig
if BOARD_KKM_C2_NRF82805

config BOARD_ENABLE_DCDC
  bool "DCDC mode"
  select SOC_DCDC_NRF52X
  default y

config BT_CTLR
  default y if BT

endif
```

## boards/arm/kkm_c2_nrf82805/Kconfig.defconfig
```kconfig
# Copyright (c) 2024 Nordic Semiconductor ASA
# SPDX-License-Identifier: Apache-2.0

if BOARD_NRF52805_EVM

config BOARD
  default "kkm_c2_nrf82805"

endif
```

## boards/arm/kkm_c2_nrf82805/Kconfig.kkm_c2_nrf82805
```kconfig
# Copyright (c) 2024 Nordic Semiconductor ASA
# SPDX-License-Identifier: Apache-2.0

config BOARD_KKM_C2_NRF82805
	bool "KKM C2 nrf52805 beacon"
	select SOC_NRF52805_CAAA
```

## boards/arm/kkm_k4p/Kconfig.defconfig
```kconfig
# Copyright (c) 2024 Nordic Semiconductor ASA
# SPDX-License-Identifier: Apache-2.0

if BOARD_KKM_K4P

config BOARD
  default "kkm_k4p"

endif
```

## boards/arm/kkm_k4p/Kconfig.kkm_k4p
```kconfig
# Copyright (c) 2024 Nordic Semiconductor ASA
# SPDX-License-Identifier: Apache-2.0

config BOARD_KKM_K4P
	bool "kkm_k4p"
	select SOC_NRF52833_QDAA
```

## boards/arm/kkm_k4p/kkm_k4p_defconfig
```kconfig
# Copyright (c) 2024 Nordic Semiconductor ASA
# SPDX-License-Identifier: Apache-2.0

# Enable MPU
CONFIG_ARM_MPU=y

# Enable hardware stack protection
CONFIG_HW_STACK_PROTECTION=y

# Enable GPIO
CONFIG_GPIO=y

CONFIG_WATCHDOG=y

CONFIG_I2C=y

# XXXX disable if quartz
CONFIG_CLOCK_CONTROL_NRF_K32SRC_RC=y
CONFIG_CLOCK_CONTROL_NRF_K32SRC_500PPM=y
```

## boards/arm/kkm_p11_nrf52810/Kconfig
```kconfig
if BOARD_KKM_P11_NRF52810

config BT_CTLR
  bool "BT_CTLR"
  default y if BT

endif
```

## boards/arm/kkm_p11_nrf52810/Kconfig.defconfig
```kconfig
if BOARD_KKM_P11_NRF52810

config BOARD
  default "kkm_p11_nrf52810"

endif # BOARD_KKM_P11_NRF52810
```

## boards/arm/kkm_p11_nrf52810/Kconfig.kkm_p11_nrf52810
```kconfig
config BOARD_KKM_P11_NRF52810
  bool "kkm_p11_nrf52810 board"
	select SOC_NRF52810_QFAA
```

## boards/arm/kkm_p1_nrf52810/Kconfig
```kconfig
if BOARD_KKM_P1_NRF52810

config BT_CTLR
  bool "BT_CTLR"
  default y if BT

endif
```

## boards/arm/kkm_p1_nrf52810/Kconfig.defconfig
```kconfig
if BOARD_KKM_P1_NRF52810

config BOARD
  default "kkm_p1_nrf52810"

endif # BOARD_KKM_P1_NRF52810
```

## boards/arm/kkm_p1_nrf52810/Kconfig.kkm_p1_nrf52810
```kconfig
config BOARD_KKM_P1_NRF52810
  bool "kkm_p1_nrf52810 board"
	select SOC_NRF52810_QFAA
```

## boards/arm/kkm_p1_nrf52810/kkm_p1_nrf52810_defconfig
```kconfig
CONFIG_ARM_MPU=y
CONFIG_HW_STACK_PROTECTION=y
CONFIG_GPIO=y
CONFIG_WATCHDOG=y
CONFIG_I2C=y
CONFIG_CLOCK_CONTROL_NRF_K32SRC_RC=n
#CONFIG_CLOCK_CONTROL_NRF_K32SRC_500PPM=y
```

## boards/arm/nrf52805_evm/Kconfig
```kconfig
if BOARD_NRF52805_EVM

config BOARD_ENABLE_DCDC
	bool "DCDC mode"
	select SOC_DCDC_NRF52X
	default y

config BT_CTLR
  default y if BT

endif
```

## boards/arm/nrf52805_evm/Kconfig.nrf52805_evm
```kconfig
# Copyright (c) 2024 Nordic Semiconductor ASA
# SPDX-License-Identifier: Apache-2.0

config BOARD_NRF52805_EVM
  bool "nrf52805_EVM board"
  select SOC_NRF52805_CAAA
```
