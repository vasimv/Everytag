## boards/arm/wb_20241007/Kconfig.wb_20241007
```kconfig
# Copyright (c) 2024 Nordic Semiconductor ASA
# SPDX-License-Identifier: Apache-2.0

config BOARD_WB_20241007
	bool "wb_20241007"
	select SOC_NRF52833_QDAA
```

## boards/arm/wb_20241125/Kconfig.defconfig
```kconfig
# Copyright (c) 2024 Nordic Semiconductor ASA
# SPDX-License-Identifier: Apache-2.0

if BOARD_WB_20241125

config BOARD
  default "wb_20241125"

endif
```
